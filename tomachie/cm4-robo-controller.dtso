/*
 * cm4-robo-controller.dtso - I2C/SPI peripheral map, machine-generated by
 * Tomachie 5.208
 * from the schematic. Two kinds of gap are marked: NEEDS REVIEW
 * (the schematic alone cannot state it - a binding name, a software
 * choice) and NOT TRACED (it is on the schematic and this tool could
 * not follow it). Complete both before use.
 *
 * Overlay for A2 (ComputeModule4-CM4) - one overlay per Linux CPU; this file
 * holds only the
 * buses A2 masters. Apply it to A2's own base devicetree.
 *
 * Apply as an overlay:  dtc -@ -O dtb -o cm4-robo-controller.dtbo
 * cm4-robo-controller.dtso
 * Or paste the &bus blocks into the board .dts - the node syntax is identical.
 * The dt-bindings includes below are resolved by the kernel-style build
 * (cpp preprocesses, then dtc compiles) - the same flow every in-tree
 * overlay uses.
 */
#include <dt-bindings/gpio/gpio.h>
#include <dt-bindings/interrupt-controller/irq.h>
#include <dt-bindings/leds/common.h>

/dts-v1/;
/plugin/;

/* NEEDS REVIEW: &spi0 is not declared by this SoC's own devicetree - the name
 * came from the designer's net names, and an overlay naming a label the SoC
 * does not define does not apply at all.
 * This SoC declares: spi3, spi4, spi5, spi6, spi, spi1, spi2 */
&spi0 {	/* MISO=SPI0_MISO MOSI=SPI0_MOSI SCK=SPI0_SCLK; controller: A2 */
	status = "okay";
	#address-cells = <1>;
	#size-cells = <0>;

	/* no on-board device - this bus goes to J4; add nodes here for devices
	 * fitted on that connector */
	/*
	 * A device fitted on J4 does not belong in this
	 * file. Put it in its own overlay targeting this label, so
	 * the board description stays intact and the add-on is
	 * applied (or not) with the hardware:
	 *
	 *     &spi0 {
	 *         <device>@<addr> {
	 *             compatible = "<vendor>,<part>";
	 *             reg = <0x..>;
	 *         };
	 *     };
	 */
};

